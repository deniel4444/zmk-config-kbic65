## config/boards/shields/kbic65/Kconfig.defconfig
```kconfig
# Copyright (c) 2020 The ZMK Contributors
# SPDX-License-Identifier: MIT

if SHIELD_KBIC65

config ZMK_KEYBOARD_NAME
	default "KBIC65"

endif
```

## config/boards/shields/kbic65/Kconfig.shield
```kconfig
# Copyright (c) 2020 The ZMK Contributors
# SPDX-License-Identifier: MIT

config SHIELD_KBIC65
	def_bool $(shields_list_contains,kbic65)
```
